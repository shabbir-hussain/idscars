/*@!Encoding:1252*/
includes
{
  
}

variables
{
 message Legitimate legit;
 mstimer timer1;
    
 int sensor=0;
  
 //101ms 
 int sendingRate = 101;
  
  //incDec
  int inc = 0;
}



on timer timer1
{
  //set up node number
  legit.NodeNumber=3;
  
  //change sensor direction
  if(sensor%120==0){
   inc=!inc;
  }
  
  //update sensor value
  if(inc){
    sensor +=1;
  }else{
    sensor -=1;
  }

  //put message on bus
  legit.sensor=sensor;
  output(legit); // output message
 
  //reset timer
  setTimer(timer1,random(sendingRate));
}


on start{
  //add some randomness
 setTimer(timer1,50);  
}
