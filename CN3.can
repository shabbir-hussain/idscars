/*@!Encoding:1252*/
includes
{
  
}

variables
{
  //milisecond timer
  msTimer T1;
}

on start{
  //add some randomness
 setTimer(T1,50);  //50 milisecond
}
on timer T1{

   //reset timer
   setTimer(T1,50);
}