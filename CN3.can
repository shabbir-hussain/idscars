/*@!Encoding:1252*/
includes
{
  
}

variables
{
 message Legitimate legit;
 mstimer timer1;
 mstimer timer2;
 mstimer timer3;
 msTimer T1;
 int runBlue = 0;
 int runOrange = 0;
 int runPurple = 0;
  
  int sensor=0;
}

on envVar StartBlue
{
  runBlue = !runBlue;
  if (runBlue == 1) setTimer(timer1,100);
}

on envVar StartOrange
{
  runOrange = !runOrange;
  if (runOrange == 1) setTimer(timer2, 100);
}

on envVar StartPurple
{
  runPurple = !runPurple;
  if (runPurple == 1) setTimer(timer3, 100);  
}

on timer timer1
{
  //if (runBlue == 1) 
  
  legit.NodeNumber=3;
  
  sensor +=1;
  sensor %=100;
  
  legit.sensor=sensor;
  output(legit); // output message

  
  setTimer(timer1,random(101));
}


on start{
  //add some randomness
 setTimer(timer1,50);  
}
